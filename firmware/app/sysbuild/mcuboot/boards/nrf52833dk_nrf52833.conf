## firmware/app/sysbuild/mcuboot/boards/nrf52833dk_nrf52833.conf
```kconfig
# MCUboot USB-C serial recovery for high-debug bench builds.
CONFIG_LOG=n
CONFIG_CONSOLE=n
CONFIG_CONSOLE_HANDLER=n
CONFIG_UART_CONSOLE=n
CONFIG_SIZE_OPTIMIZATIONS=y
CONFIG_PM_PARTITION_SIZE_MCUBOOT=0x10000

CONFIG_FLASH=y
CONFIG_FLASH_MAP=y
CONFIG_FLASH_PAGE_LAYOUT=y
CONFIG_SOC_FLASH_NRF=y

CONFIG_SERIAL=y
CONFIG_UART_NRFX=y
CONFIG_UART_INTERRUPT_DRIVEN=y
CONFIG_UART_LINE_CTRL=y

CONFIG_GPIO=y
CONFIG_MCUBOOT_SERIAL=y
CONFIG_BOOT_SERIAL_CDC_ACM=y
CONFIG_BOOT_SERIAL_ENTRANCE_GPIO=n
CONFIG_BOOT_SERIAL_WAIT_FOR_DFU=y
CONFIG_BOOT_SERIAL_WAIT_FOR_DFU_TIMEOUT=3000
CONFIG_BOOT_SERIAL_BOOT_MODE=y
CONFIG_BOOT_SERIAL_NO_APPLICATION=y
CONFIG_SINGLE_APPLICATION_SLOT=y

CONFIG_RETAINED_MEM=y
CONFIG_RETAINED_MEM_NRF_GPREGRET=y
CONFIG_RETENTION=y
CONFIG_RETENTION_BOOT_MODE=y

CONFIG_MULTITHREADING=y
CONFIG_USB_DEVICE_STACK=y
CONFIG_USB_DEVICE_PRODUCT="IMEC MCUboot"
CONFIG_USB_CDC_ACM=y
CONFIG_USB_COMPOSITE_DEVICE=y
CONFIG_USB_DEVICE_MANUFACTURER="IMEC"
CONFIG_USB_DEVICE_VID=0x1915
CONFIG_USB_DEVICE_PID=0x520F
```

## firmware/tests/mesh_integration/production_seam_click_handoff/gateway_host_recovery/testcase.yaml
```yaml
tests:
  imec2.production_seam.gateway_host_recovery:
    tags:
      - mesh_integration
      - hardware_models
      - production_seam
      - gateway
      - custody
      - recovery
    platform_allow:
      - native_sim/native/64
    integration_platforms:
      - native_sim/native/64
```

## firmware/tests/mesh_integration/production_seam_click_handoff/gateway_result_actions/testcase.yaml
```yaml
tests:
  imec2.production_seam.gateway_result_actions:
    tags:
      - mesh_integration
      - hardware_models
      - production_seam
      - gateway
      - custody
    platform_allow:
      - native_sim/native/64
    integration_platforms:
      - native_sim/native/64
```

## firmware/tests/mesh_integration/production_seam_click_handoff/report_custody/testcase.yaml
```yaml
tests:
  imec2.production_seam.report_custody:
    tags:
      - imec2
      - mesh
      - production_seam
      - custody
      - capacity
    platform_allow:
      - native_sim/native/64
    integration_platforms:
      - native_sim/native/64
    harness: ztest
```

## firmware/tests/mesh_integration/production_seam_click_handoff/testcase.yaml
```yaml
tests:
  imec2.production_seam.click_handoff_repair:
    tags:
      - imec2
      - mesh
      - production_seam
      - radio
      - workqueue
    platform_allow:
      - native_sim/native/64
    integration_platforms:
      - native_sim/native/64
    harness: ztest
```

## firmware/tests/mesh_integration/production_seam_click_preempt_priority/testcase.yaml
```yaml
tests:
  imec2.production_seam.click_preempt_priority:
    platform_allow:
      - native_sim/native/64
    tags:
      - production_seam
      - workqueue
      - click
```
