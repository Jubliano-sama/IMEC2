## CMakeLists.txt
```
cmake_minimum_required(VERSION 3.20.0)

find_package(Zephyr REQUIRED HINTS $ENV{ZEPHYR_BASE})
project(click_event_sequence_persistence_test)

target_compile_definitions(app PRIVATE
    CONFIG_IMEC_CLICK_EVENT_SEQUENCE_PERSISTENCE=1
    DEVICE_ROLE=1
)

target_include_directories(app PRIVATE
    ${CMAKE_CURRENT_LIST_DIR}/../../src
)

target_sources(app PRIVATE
    src/main.c
    ../../src/app_nvs_storage.c
    ../../src/app_click_event_sequence.c
)
```

## prj.conf
```kconfig
CONFIG_FLASH=y
CONFIG_FLASH_MAP=y
CONFIG_FLASH_PAGE_LAYOUT=y
CONFIG_NVS=y
CONFIG_NVS_DATA_CRC=y
CONFIG_MPU_ALLOW_FLASH_WRITE=y

CONFIG_LOG=y
CONFIG_LOG_MODE_IMMEDIATE=y
CONFIG_LOG_DEFAULT_LEVEL=3
```

## boards/native_sim.overlay
```dts
&flash0 {
    erase-block-size = <0x400>;
};

&storage_partition {
    reg = <0x000fc000 0x00004000>;
};
```

## src/main.c
```c
#include "app_click_event_sequence.h"

#include "posix_board_if.h"

#include <zephyr/sys/printk.h>
#include <zephyr/sys/util.h>

#include <stdint.h>

BUILD_ASSERT(APP_CLICK_EVENT_SEQUENCE_FIRST_INSTALL_FLOOR == 0x01000000u,
             "native migration fixture expects the documented install floor");
BUILD_ASSERT(APP_CLICK_EVENT_SEQUENCE_MAX_BOOT_RESERVATIONS == 16711679u,
             "native migration fixture expects the documented boot bound");

int main(void)
{
    uint32_t first;
    uint32_t second;
    int ret;

    ret = app_click_event_sequence_init();
    if (ret < 0) {
        printk("CLICK_EVENT_SEQUENCE init_failed=%d\n", ret);
        posix_exit(1);
        return 1;
    }
    ret = app_click_event_sequence_next(&first);
    if (ret < 0) {
        printk("CLICK_EVENT_SEQUENCE first_failed=%d\n", ret);
        posix_exit(2);
        return 2;
    }
    ret = app_click_event_sequence_next(&second);
    if (ret < 0) {
        printk("CLICK_EVENT_SEQUENCE second_failed=%d\n", ret);
        posix_exit(3);
        return 3;
    }
    if (first == 0u || second != first + 1u ||
        ((first - 1u) % APP_CLICK_EVENT_SEQUENCE_BLOCK_SIZE) != 0u) {
        printk("CLICK_EVENT_SEQUENCE invalid first=%u second=%u\n",
               first,
               second);
        posix_exit(4);
        return 4;
    }

    printk("CLICK_EVENT_SEQUENCE first=%u second=%u block=%u max_boots=%u\n",
           first,
           second,
           APP_CLICK_EVENT_SEQUENCE_BLOCK_SIZE,
           APP_CLICK_EVENT_SEQUENCE_MAX_BOOT_RESERVATIONS);
    posix_exit(0);
    return 0;
}
```
